## external/Config.in
```kconfig
menu "Talaria Display OS"

source "$BR2_EXTERNAL_TALARIA_DISPLAY_OS_PATH/package/plymouth/Config.in"

config BR2_PACKAGE_TALARIA_DISPLAY_OS_NOTES
	bool "Talaria display OS project notes"
	help
	  This external tree currently provides board files, rootfs overlays,
	  and scripts for the Talaria Display OS proof of concept. The image
	  boots to local diagnostics by default and can supervise a kiosk
	  browser for dashboard and signage modes once assigned.

endmenu
```

## external/configs/talaria_dashboard_x86_64_defconfig
```kconfig
BR2_x86_64=y
BR2_TOOLCHAIN_BUILDROOT_WCHAR=y
BR2_TOOLCHAIN_BUILDROOT_CXX=y
BR2_TARGET_GENERIC_HOSTNAME="talaria-dashboard"
BR2_TARGET_GENERIC_ISSUE="Talaria Dashboard OS phase 1"
BR2_ROOTFS_DEVICE_CREATION_DYNAMIC_EUDEV=y
BR2_SYSTEM_DHCP="eth0"
BR2_ROOTFS_OVERLAY="$(BR2_EXTERNAL_TALARIA_DASHBOARD_OS_PATH)/board/talaria/dashboard-x86_64/rootfs_overlay"
BR2_ROOTFS_POST_BUILD_SCRIPT="$(BR2_EXTERNAL_TALARIA_DASHBOARD_OS_PATH)/board/talaria/dashboard-x86_64/post-build.sh"
BR2_ROOTFS_POST_IMAGE_SCRIPT="support/scripts/genimage.sh $(BR2_EXTERNAL_TALARIA_DASHBOARD_OS_PATH)/board/talaria/dashboard-x86_64/post-image.sh"
BR2_ROOTFS_POST_SCRIPT_ARGS="-c $(BR2_EXTERNAL_TALARIA_DASHBOARD_OS_PATH)/board/talaria/dashboard-x86_64/genimage-bios.cfg"
BR2_KERNEL_HEADERS_AS_KERNEL=y
BR2_PACKAGE_HOST_LINUX_HEADERS_CUSTOM_6_12=y
BR2_LINUX_KERNEL=y
BR2_LINUX_KERNEL_CUSTOM_VERSION=y
BR2_LINUX_KERNEL_CUSTOM_VERSION_VALUE="6.12.94"
BR2_LINUX_KERNEL_USE_ARCH_DEFAULT_CONFIG=y
BR2_LINUX_KERNEL_NEEDS_HOST_OPENSSL=y
BR2_LINUX_KERNEL_NEEDS_HOST_LIBELF=y
BR2_LINUX_KERNEL_INSTALL_TARGET=y
BR2_TARGET_ROOTFS_EXT2=y
BR2_TARGET_ROOTFS_EXT2_4=y
BR2_TARGET_ROOTFS_EXT2_SIZE="256M"
# BR2_TARGET_ROOTFS_TAR is not set
BR2_TARGET_GRUB2=y
BR2_TARGET_GRUB2_I386_PC=y
BR2_TARGET_GRUB2_CFG="$(BR2_EXTERNAL_TALARIA_DASHBOARD_OS_PATH)/board/talaria/dashboard-x86_64/grub-bios.cfg"
BR2_PACKAGE_CA_CERTIFICATES=y
BR2_PACKAGE_ETHTOOL=y
BR2_PACKAGE_IPROUTE2=y
BR2_PACKAGE_KMOD=y
BR2_PACKAGE_UTIL_LINUX=y
BR2_PACKAGE_UTIL_LINUX_MOUNT=y
BR2_PACKAGE_UTIL_LINUX_BLKID=y
BR2_PACKAGE_UTIL_LINUX_LSBLK=y
BR2_PACKAGE_HOST_GENIMAGE=y
BR2_PACKAGE_HOST_DOSFSTOOLS=y
BR2_PACKAGE_HOST_MTOOLS=y
```

## external/package/plymouth/Config.in
```kconfig
config BR2_PACKAGE_PLYMOUTH
	bool "plymouth"
	depends on BR2_USE_MMU
	depends on !BR2_STATIC_LIBS
	depends on BR2_TOOLCHAIN_HAS_THREADS
	depends on BR2_PACKAGE_HAS_UDEV
	select BR2_PACKAGE_FREETYPE
	select BR2_PACKAGE_LIBDRM
	select BR2_PACKAGE_LIBEVDEV
	select BR2_PACKAGE_LIBPNG
	select BR2_PACKAGE_LIBXKBCOMMON
	select BR2_PACKAGE_XKEYBOARD_CONFIG
	help
	  Plymouth provides a graphical boot splash and boot-time status
	  messaging. The Talaria image uses it with the script theme,
	  DRM/KMS renderer, and the baked Talaria theme assets.

	  https://www.freedesktop.org/wiki/Software/Plymouth/

comment "plymouth needs udev /dev management"
	depends on BR2_USE_MMU
	depends on !BR2_PACKAGE_HAS_UDEV

comment "plymouth needs a toolchain w/ threads, dynamic library"
	depends on BR2_USE_MMU
	depends on !BR2_TOOLCHAIN_HAS_THREADS || BR2_STATIC_LIBS
```
